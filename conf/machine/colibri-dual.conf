## conf/machine/colibri-dual.conf
```bitbake
#@TYPE: Machine
#@NAME: Colibri i.MX6 Colibri Duallite
#@SOC: i.MX6DL
#@DESCRIPTION: Machine configuration for i.MX6 Colibri Duallite
#@MAINTAINER:

include include/colibri.inc

SOC_FAMILY = "mx6:mx6dl:wandboard"

UBOOT_MACHINE = "colibri_dl_config"

KERNEL_DEVICETREE = "imx6dl-colibri.dtb"

MACHINE_FEATURES += "bluetooth wifi"

MACHINE_EXTRA_RRECOMMENDS += " \
  bcm4329-nvram-config \
  bcm4330-nvram-config \
"
```

## conf/machine/colibri-quad.conf
```bitbake
#@TYPE: Machine
#@NAME: Colibri i.MX6 Colibri Quad
#@SOC: i.MX6Q
#@DESCRIPTION: Machine configuration for i.MX6 Colibri Quad
#@MAINTAINER:

include include/colibri.inc

SOC_FAMILY = "mx6:mx6q:wandboard"

UBOOT_MACHINE = "colibri_quad_config"

KERNEL_DEVICETREE = "imx6q-colibri.dtb"

MACHINE_FEATURES += "bluetooth wifi"

MACHINE_EXTRA_RRECOMMENDS += " \
  bcm4329-nvram-config \
  bcm4330-nvram-config \
"
```

## conf/machine/colibri-solo.conf
```bitbake
#@TYPE: Machine
#@NAME: Colibri i.MX6 Colibri Solo
#@SOC: i.MX6S
#@DESCRIPTION: Machine configuration for i.MX6 Colibri Solo
#@MAINTAINER:

include include/colibri.inc

SOC_FAMILY = "mx6:mx6dl:wandboard"

UBOOT_MACHINE = "colibri_solo_config"

KERNEL_DEVICETREE = "imx6dl-colibri.dtb"
```

## conf/machine/colibri.conf
```bitbake
#@TYPE: Machine
#@NAME: Colibri i.MX6 Colibri Quad/Dual/Solo
#@SOC: i.MX6Q/DL
#@DESCRIPTION: Machine configuration for i.MX6 Colibri Quad
#@MAINTAINER: Martin Stoilov <martin@sigmadrone.org>

include conf/machine/include/imx-base.inc
include conf/machine/include/tune-cortexa9.inc

SOC_FAMILY = "mx6:mx6dl:mx6q"

PREFERRED_PROVIDER_u-boot = "u-boot-colibri"
PREFERRED_PROVIDER_virtual/kernel ?= "linux-colibri"
PREFERRED_VERSION_linux-colibri ?= "3.14.28"
PREFERRED_PROVIDER_sshd ?= "openssh"
PREFERRED_PROVIDER_jpeg-native ?= "jpeg-native"

# Because hostapd v1 does not seem to work with the BCM4329
PREFERRED_VERSION_hostap-daemon = "2.0"

IMAGE_INSTALL_append = " \
		     sshd \
		     i2c-tools \
		     nfs-utils \
		     nfs-utils-client \
		     json-glib \
		     libjson \
		     boost \
		     linux-firmware \
		     hostapd \
		     dhcp-server \
		     dhcp-server-config \
		     openssh-sftp-server \
		     gdb \
		     gdbserver \
		     lighttpd \
		     sigmad \
"

UBOOT_MAKE_TARGET = ""
UBOOT_SUFFIX = "img"
SPL_BINARY = "SPL"
UBOOT_MACHINE = "colibri_config"

KERNEL_DEVICETREE = "imx6q-colibri.dtb \
                     imx6dl-colibri.dtb"
KERNEL_IMAGETYPE = "zImage"

MACHINE_FEATURES += "bluetooth pci wifi touchscreen"

MACHINE_EXTRA_RRECOMMENDS += " \
  bcm4329-nvram-config \
  bcm4330-nvram-config \
"

SERIAL_CONSOLE = "115200 ttymxc0"
```

## conf/machine/include/colibri.inc
```bitbake
# Common settings for wandboard boards

include conf/machine/include/imx-base.inc
include conf/machine/include/tune-cortexa9.inc

PREFERRED_PROVIDER_u-boot = "u-boot-colibri"
PREFERRED_PROVIDER_virtual/kernel ?= "linux-colibri"
PREFERRED_VERSION_linux-colibri ?= "3.10.17"
PREFERRED_PROVIDER_sshd ?= "openssh"
PREFERRED_PROVIDER_jpeg-native ?= "jpeg-native"

# Because hostapd v1 does not seem to work with the BCM4329
PREFERRED_VERSION_hostap-daemon = "2.0"

SERIAL_CONSOLE = "115200 ttymxc1"

MACHINE_FEATURES += "pci touchscreen"

IMAGE_INSTALL_append = " \
	sshd \
	i2c-tools \
	nfs-utils \
	nfs-utils-client \
	json-glib \
	libjson \
	boost \
	linux-firmware \
	hostapd \
	dhcp-server \
	dhcp-server-config \
	openssh-sftp-server \
	gdb \
	gdbserver \
	lighttpd \
	sigmad \
"

KERNEL_IMAGETYPE = "zImage"
```
